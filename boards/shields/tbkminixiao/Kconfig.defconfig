## boards/shields/tbkminixiao/Kconfig.defconfig
```kconfig
if SHIELD_TBKMINIXIAO_LEFT || SHIELD_TBKMINIXIAO_DONGLE

# Name must be less than 16 characters long!
config ZMK_KEYBOARD_NAME
    default "TBKMiniXIAO"


config LOG_PROCESS_THREAD_STARTUP_DELAY_MS
    default 8000

endif

if SHIELD_TBKMINIXIAO_LEFT || SHIELD_TBKMINIXIAO_RIGHT

config ZMK_SPLIT
    default y

config ZMK_SPLIT_ROLE_CENTRAL
    default n
    
endif





if SHIELD_TBKMINIXIAO_DONGLE

config ZMK_SPLIT
    default y

config ZMK_SPLIT_ROLE_CENTRAL
    default y



# Set this to the number of peripherals your dongle will have.
# For a unibody, this would be 1. If you have left and right halves, set it to 2, etc.
config ZMK_SPLIT_BLE_CENTRAL_PERIPHERALS
    default 2

# Set this to ZMK_SPLIT_BLE_CENTRAL_PERIPHERALS + your desired number of BT profiles (default is 5)
config BT_MAX_CONN
    default 7

# Set this to the same number as BT_MAX_CONN
config BT_MAX_PAIRED
    default 7

endif
```

## boards/shields/tbkminixiao/Kconfig.shield
```kconfig
# No whitespace after the comma or in your part name!
config SHIELD_TBKMINIXIAO_LEFT
    def_bool $(shields_list_contains,tbkminixiao_left)

# No whitespace after the comma or in your part name!
config SHIELD_TBKMINIXIAO_RIGHT
    def_bool $(shields_list_contains,tbkminixiao_right)

# No whitespace after the comma or in the keyboard name!
config SHIELD_TBKMINIXIAO_DONGLE
    def_bool $(shields_list_contains,tbkminixiao_dongle)
```

## config/west.yml
```yaml
manifest: 
  defaults:
    revision: v0.2
  remotes:
    - name: zmkfirmware
      url-base: https://github.com/zmkfirmware
    # Additional modules containing boards/shields/custom code can be listed here as well
    - name: caksoylar  # 
      url-base: https://github.com/caksoylar  
  
  projects:
    - name: zmk
      remote: zmkfirmware
      revision: v0.2
      import: app/west.yml
    - name: zmk-rgbled-widget 
      remote: caksoylar
      revision: main
  self:
    path: config
```
